## apps/tuya.ai/ai_components/ai_audio/Kconfig
```kconfig
menuconfig ENABLE_COMP_AI_AUDIO
    select ENABLE_AUDIO_CODECS
    bool "enable ai audio input/output"
    default y

if (ENABLE_COMP_AI_AUDIO)
    choice
        prompt "select ai audio input codec"
        default ENABLE_COMP_AI_AUDIO_CODEC_PCM

    config ENABLE_COMP_AI_AUDIO_CODEC_PCM
        bool "enable ai audio pcm codec"

    config ENABLE_COMP_AI_AUDIO_CODEC_OPUS
        bool "enable ai audio opus codec"

    config ENABLE_COMP_AI_AUDIO_CODEC_SPEEX
        bool "enable ai audio speex codec"

    endchoice
endif
```

## apps/tuya.ai/ai_components/ai_ui/Kconfig
```kconfig
menuconfig ENABLE_COMP_AI_DISPLAY
    select ENABLE_DISPLAY
    bool "enable ai chat display ui"
    default y

if (ENABLE_COMP_AI_DISPLAY) 
choice
    prompt "choose display gui"
    default ENABLE_AI_CHAT_GUI_WECHAT

    config ENABLE_AI_CHAT_GUI_WECHAT
        select ENABLE_LIBLVGL
        bool "Use WeChat-like ui"

    config ENABLE_AI_CHAT_GUI_CHATBOT
        select ENABLE_LIBLVGL
        bool "Use Chatbot ui"

    config ENABLE_AI_CHAT_GUI_OLED
        select ENABLE_LIBLVGL
        bool "Use OLED ui"

    config ENABLE_AI_CHAT_GUI_CUSTOM
        bool "Use user custom"
endchoice

config ENABLE_CIRCLE_UI_STYLE
    depends on ENABLE_AI_CHAT_GUI_CHATBOT
    bool "Enable circle ui style"
    default n

if(!ENABLE_AI_CHAT_GUI_CUSTOM)
choice 
    prompt "choose text font size"
    default FONT_TEXT_SIZE_18_2

    config FONT_TEXT_SIZE_14_1
        bool "Text font size 14"

    config FONT_TEXT_SIZE_18_2
        bool "Text font size 18"

    config FONT_TEXT_SIZE_20_4
        bool "Text font size 20"

    config FONT_TEXT_SIZE_30_4
        bool "Text font size 30"
endchoice

choice 
    prompt "choose icon font size"
    default FONT_ICON_SIZE_16_4 

    config FONT_ICON_SIZE_14_1
        bool "Icon font size 14"

    config FONT_ICON_SIZE_16_4
        bool "Icon font size 16"

    config FONT_ICON_SIZE_20_4
        bool "Icon font size 20"

    config FONT_ICON_SIZE_30_4
        bool "Icon font size 30"
endchoice

choice 
    prompt "choose emo font type"
    default FONT_EMOJI_SIZE_32 if(ENABLE_AI_CHAT_GUI_WECHAT)
    default FONT_EMOJI_SIZE_64 if(ENABLE_AI_CHAT_GUI_CHATBOT)

    config FONT_EMOJI_SIZE_32
        bool "Emoji font size 32"

    config FONT_EMOJI_SIZE_64
        bool "Emoji font size 64"

    config FONT_EMO_AWESOME
        bool "Emoji font awesome"
endchoice

endif

endif
```

## boards/T5AI/TUYA_T5AI_EINK_NFC/Kconfig
```kconfig
config CHIP_CHOICE
    string
    default "T5AI"

config BOARD_CHOICE
    string
    default "TUYA_T5AI_EINK_NFC"

config BOARD_CONFIG
    bool
    default y
    select ENABLE_AUDIO_CODECS
    select ENABLE_AUDIO_AEC
    select ENABLE_LED
    select ENABLE_BUTTON
    select ENABLE_BUTTON_2
    select ENABLE_BUTTON_3
    select ENABLE_BUTTON_4
    select ENABLE_BUTTON_5
    select ENABLE_BUTTON_6
```
